/ {
    chosen {
        zmk,kscan = &kscan0;
    };
};

&kscan0 {
    label = "KSCAN";
    
    // 行スキャンに使用するGPIOピンを指定
    row-gpios = < &gpio0 2 GPIO_ACTIVE_LOW >,  // P0.02
                 < &gpio0 3 GPIO_ACTIVE_LOW >,  // P0.03
                 < &gpio0 4 GPIO_ACTIVE_LOW >,  // P0.04
                 < &gpio0 5 GPIO_ACTIVE_LOW >;  // P0.05

    // 列スキャンに使用するGPIOピンを指定
    col-gpios = < &gpio0 6 GPIO_ACTIVE_LOW >,  // P0.06
                 < &gpio0 7 GPIO_ACTIVE_LOW >,  // P0.07
                 < &gpio0 8 GPIO_ACTIVE_LOW >;  // P0.08

    // ダイオードの方向を指定（col2row または row2col）
    diode-direction = "col2row";
};