/ {
    chosen {
        zmk,kscan = &kscan0;
    };
};
#include "shapekey_test.dtsi"

/ {
    kscan0: kscan0 {
        compatible = "zmk,kscan-gpio-matrix";
        diode-direction = "col2row";
        wakeup-source;

        col-gpios
            = <&xiao_d  6 GPIO_ACTIVE_HIGH>
            , <&xiao_d  9 GPIO_ACTIVE_HIGH>
            , <&xiao_d  7 GPIO_ACTIVE_HIGH>
            ;

        row-gpios
            = <&xiao_d  3 (GPIO_ACTIVE_HIGH | GPIO_PULL_DOWN)>
            , <&xiao_d  8 (GPIO_ACTIVE_HIGH | GPIO_PULL_DOWN)>
            , <&xiao_d  1 (GPIO_ACTIVE_HIGH | GPIO_PULL_DOWN)>
            ;
    };
};
/ {
    chosen {
        zmk,physical-layout = &physical_layout0;
    };

    physical_layout0: physical_layout {
        compatible = "zmk,physical-layout";
        display-name = "Shapekey Test Layout";
        rows = <3>;
        columns = <3>;
        keymap = <
            0 1 2   // 1行目
            3 4 5   // 2行目
            6 7 8   // 3行目
        >;
        
         transform = <
            0 1 2   // 行列スキャン順序
            3 4 5
            6 7 8
        >;
    };
};